## components/argon_kernel/Kconfig
```kconfig
menu "ArgonOS"

    config ARGON_APP_ARENA_KB
        int "Application code arena, KB"
        range 4 192
        default 64
        help
            Executable RAM reserved at link time for the code part of a running
            application: literals, instructions, and any constant the image
            asked to keep here with AG_HOT_RODATA.  Ordinary constants travel
            with the data, in extended memory, and do not come out of this.

            It has to be reserved rather than allocated because ESP-IDF hands
            none of the memory that is both executable and writable through one
            address to the heap - MALLOC_CAP_EXEC reports zero bytes free - and
            an image has to be written before it can be executed.

            Every byte of it is taken out of the internal heap whether an
            application is running or not, because the executable window and the
            data window reach the same physical SRAM.  Raise it for larger
            applications, lower it if the kernel needs the internal memory.

            The data part of an application does not come from here; it is
            allocated from extended memory (PSRAM), so statics and bss are not
            bounded by this number.

    config ARGON_APP_STACK_KB
        int "Default application stack, KB"
        range 2 64
        default 16
        help
            Stack for the task an application runs on, when its image does not
            ask for a size of its own.  It comes from the internal heap for the
            lifetime of the application, and it is guarded: overrunning it is
            caught by FreeRTOS rather than quietly corrupting the shell.

    config ARGON_ENABLE_ADC
        bool "Analogue input (io->adc_read)"
        default n
        help
            Links ESP-IDF's ADC driver and makes io->adc_read work.  Off by
            default, and the reason is not taste.

            esp_adc installs a C constructor, adc_hw_calibration(), which runs
            before app_main and reads the calibration state machine of the
            analogue front end.  QEMU does not model that state machine, so the
            board stops there - before the console exists, with nothing on the
            screen after the ESP-IDF banner.  Merely linking the component is
            enough; no call of ours is involved.

            Since the whole system is verified in QEMU, a build that cannot boot
            there cannot be verified at all, so the default build leaves the ADC
            out and io->adc_read is NULL.  Turn this on for a real board, where
            the calibration works, and expect QEMU to stop booting.

    config ARGON_ENABLE_AUDIO
        bool "Sound output hardware (/dev/pcm0)"
        default n
        help
            Links the machine's own PCM output and registers /dev/pcm0, which
            is what `--out audio` and audio_out=i2s in a config already mean.

            Off by default because most targets have nothing to link: the
            original ESP32 has a pair of 8-bit converters on fixed pins and the
            ESP32-S3 has none at all, and QEMU models neither.  With this off
            the only sink is the mute /dev/pcmnull and every program that plays
            sound still runs.

            What it costs when something is playing is about four kilobytes of
            DMA buffers, taken on the first write and given back on close.

    config ARGON_ENABLE_PM
        bool "Frequency scaling (power eco)"
        default n
        select PM_ENABLE
        help
            Links ESP-IDF's power management, which is the only supported way
            to change the processor's clock while the system is running.

            With this off nothing about `power` disappears: the modes still
            change, the screen still goes out, the applications are still told
            and the journal still records it - the clock simply stays where it
            is, and the command says so in as many words.

            It does not fit everywhere.  On the ESP32-S3 image, enabling it
            overflows the data segment by about a kilobyte: ESP-IDF's power
            management keeps its locks and its scaling state in internal RAM,
            and that image has none to spare.  The ESP32 image - the board with
            a battery connector on it, which is the one that needs this - links
            with room left.

            Off by default for the same reason the ADC is: what it does cannot
            be verified in the emulator.  QEMU models a clock tree that does
            not change, so a build with this on is a build whose central claim
            is untested until it is on a board with a meter on it.

            It is also not free on hardware.  Lowering the processor's clock
            lowers the peripheral bus with it, and every driver that talks to a
            bus has to take a lock while it does so - ESP-IDF's drivers do, the
            ones in this tree go through those, and anything that latched a
            divider without asking talks at the wrong rate afterwards.  The
            console is the one to watch: garbage on the serial port is the
            failure this arrangement produces, and a board that cannot be
            talked to cannot be told to speed up again.

            Turn it on for a board, measure the milliamps at each setting, and
            write the numbers down - see docs/11-power.md.

    config ARGON_CONSOLE_KEY_EVENTS
        bool "Request key-up events from the terminal"
        default n
        help
            On console attach, ask the host terminal for a keyboard protocol
            that reports key releases (kitty CSI u with event types, and
            Windows Terminal win32-input-mode).  The decoder already understands
            those sequences; this only sends the enable request.

            Classic cmd.exe and PuTTY ignore the request, so leave this off
            unless the console is Windows Terminal, kitty, or WezTerm.  Emulator
            play in QEMU should use HostFS PADPUSH instead - that path already
            has real level state from a Win32 keyboard hook.

    config ARGON_ENABLE_NET
        bool "Networking (api->net)"
        default y
        select ETH_USE_OPENETH
        help
            Brings up a thin socket API (api->net) and, for now, the OpenCores
            Ethernet MAC that Espressif QEMU emulates.  That is the path for
            streaming PCM to a Windows host without the UART bottleneck.

            OpenEth does not exist on a real chip and the radio does not exist
            in QEMU, so which link is built is a second option below.  A failed
            bring-up is non-fatal either way; the table stays present but
            ready() stays false.

    config ARGON_NET_WIFI
        bool "...over the radio instead of OpenEth"
        depends on ARGON_ENABLE_NET
        default n
        select ESP_WIFI_ENABLED
        help
            Brings the network up on Wi-Fi, station mode, instead of the
            OpenCores Ethernet MAC that Espressif's QEMU emulates.  Above the
            port nothing changes: the same api->net, the same sockets, the same
            address printed by the same line.

            It is not the default because it cannot be verified in QEMU, which
            models no radio at all - a build with this on boots on hardware and
            has no network in the emulator.  It also costs: the Wi-Fi stack is
            tens of kilobytes of RAM on a chip whose whole internal memory is
            320, and every one of them is taken whether a network is joined or
            not.

            Which network to join comes from [wifi] in SYSTEM.CFG or from the
            `wifi` command; the radio starts joined to nothing.

    config ARGON_NET_WIFI_AP
        bool "...and can run its own access point"
        depends on ARGON_NET_WIFI
        default y
        help
            Lets the board offer a network of its own, not only join one: a
            fixed-name access point a phone connects to directly, so the card is
            reachable in a browser with no router in between.  `wifi ap <name>
            [key]` turns it on; [ap] in SYSTEM.CFG brings it up at boot.

            On by default because it is cheap next to the radio it rides on -
            the Wi-Fi stack is already linked once ARGON_NET_WIFI is set, and the
            point adds a second netif and a DHCP server, a few kilobytes taken
            only while the point is actually up.  Turn it off for a station-only
            board that wants those kilobytes back at link time.

            This chip has one radio: while the board is also joined to a network
            the point is forced onto that network's channel, and `wifi` says
            which channel it ended up on.

    config ARGON_NET_ESPNOW
        bool "...and can talk to another board with ESP-NOW"
        depends on ARGON_NET_WIFI
        default y
        help
            Board-to-board datagrams on the same radio, with no access point
            and no association between them: two boards on one channel throw
            short frames straight at each other's hardware address.  `espnow`
            sends and listens; a sensor with no router in the room reaches its
            sibling this way.

            On by default and cheap - it is the Wi-Fi stack, already linked,
            used a different way; the only cost of its own is a small receive
            queue in the kernel, taken while `espnow` is on and given back when
            it is off.  Turn it off for a board that has nothing to say to
            another board.

            Not verifiable in QEMU, which models no radio: it takes two real
            boards on one channel.

    config ARGON_NET_WIFI_MON
        bool "...and can watch the air and inject raw frames"
        depends on ARGON_NET_WIFI
        default n
        help
            Monitor mode and raw 802.11 injection: the radio turned into a
            receiver on one channel, handing up every frame it hears whether it
            is addressed to this board or not, and a way to put frames of the
            board's own making on the air.  `mon` watches, sweeps channels and
            lists what it sees; `mon tx`/`deauth`/`beacon` inject.

            Off by default, and unlike the access point and ESP-NOW that is a
            decision, not thrift.  A board that joins and serves networks is a
            participant; a board that listens to everyone's frames and forges
            its own is a different kind of thing, and it should be that kind of
            thing only because whoever built the image chose it - see the
            security note in docs/04-roadmap.md, phase 6.  The capture ring is a
            couple of kilobytes, taken only while `mon` is on.

            Legitimate for testing a driver, measuring a channel, or security
            work on networks you are allowed to touch.  Not verifiable in QEMU,
            which models no radio.

    config ARGON_BOARD_PROBE
        bool "Board probe instead of the system"
        default n
        help
            Builds an image that talks to one peripheral and nothing else: no
            scheduler, no console task, no drivers, no pin table.  It runs from
            app_main and never starts the kernel.

            For the case where a peripheral answers nothing and there are four
            possible reasons at once - the wiring, the driver, the way the
            kernel polls it, and the claims on its pins.  This removes three of
            them in one flash.  What it probes is in main/probe.c and is
            expected to be edited; it is a bring-up tool, not a feature.

    config ARGON_ENABLE_BLE
        bool "Bluetooth Low Energy (input devices)"
        default n
        select BT_ENABLED
        select BT_NIMBLE_ENABLED
        help
            The host side of BLE, so that a keyboard or a mouse can be attached
            to a board whose chip has no USB - which the original ESP32 has
            not, at all.  `bt` scans and pairs; a keyboard's reports arrive as
            ordinary console events, so the shell, the editor and the file
            manager do not know the difference.

            It rides in the same image as Wi-Fi - both stacks are linked and
            the board's own default (sdkconfig.defaults.esp32) enables both -
            because code in flash costs no RAM until something runs it, and
            neither radio starts until asked: `wifi on` / `bt on`, or a
            [wifi]/[ap]/[bt] in SYSTEM.CFG, brings one up later.

            What does not fit is running both at once.  With both radios up the
            general heap drops to single-digit kilobytes (the memory table in
            docs/09-esp32-cyd.md: ~11 KB free, largest block ~7), below what an
            application needs - so the board runs one radio at a time.  A board
            that genuinely needs both up together wants an S3 with PSRAM.

            Also not verifiable in QEMU, which models no radio.

    config ARGON_BLE_CENTRAL
        bool "General BLE central (scan/observe, and later GATT client)"
        depends on ARGON_ENABLE_BLE
        default y
        help
            Everything a BLE central does beyond attaching a keyboard.  `ble`
            listens to what every device in range advertises and says what each
            is - name, address, signal, whether it is connectable, its services,
            its maker; and (added incrementally) connects to an arbitrary device
            to read and write an arbitrary characteristic, not only HID.

            On by default and cheap - it rides the NimBLE host the keyboard host
            already starts, so it adds code but no second controller.  Turn it
            off for a board that only ever wants a keyboard.

            Not verifiable in QEMU, which models no radio.

    config ARGON_BLE_PERIPHERAL
        bool "BLE peripheral (the board is seen and connected to)"
        depends on ARGON_ENABLE_BLE
        default y
        help
            The other direction from central: the board advertises a name and
            holds a small GATT server, so a phone or PC connects to it and reads
            and writes a characteristic.  `ble adv <name>` starts it.

            On by default; it registers one custom service in the NimBLE host
            the keyboard already runs.  Turn it off for a board that should
            never be connectable - a keyboard host that stays invisible.

            Not verifiable in QEMU, which models no radio.

    config ARGON_CONSOLE_COLS
        int "Console width, characters"
        range 20 240
        default 80

    config ARGON_CONSOLE_ROWS
        int "Console height, characters"
        range 10 128
        default 25
        help
            The text screen every endpoint renders: the serial console, the
            local framebuffer and a panel driver all show this one grid.

            Eighty by twenty-five unless the board's own screen cannot hold it.
            The system draws 8x8 cells on a panel, so a 320x240 display holds
            forty by thirty, and a console wider than the only screen attached
            to the machine is one whose right-hand half nobody ever sees.

            Not a runtime setting, and not in BOARD.CFG: the console is built
            three stages before any file has been read, and everything printed
            during those stages would be lost by rebuilding it afterwards.

    config ARGON_ENABLE_HOSTFS
        bool "HostFS (H:, live host folder over UART1)"
        default y
        help
            Mounts a folder on the development machine as drive H: by talking
            to tools/hostfsd.py over UART1.  It is how applications, ROMs and
            pad input reach the guest under QEMU, and it is the reason the
            emulator is a usable development environment at all.

            There is no host helper on a real board, and there never will be.
            Leaving this on there costs 80 KB of DRAM for the UART buffers,
            allocated whether the helper answers or not, plus 100 ms of every
            boot on a PING nobody replies to (trap 29).  On a chip with no
            PSRAM that is a large fraction of the memory an application was
            going to get, so hardware targets turn it off.

endmenu
```
